#include <SPI.h>
#include <MFRC522.h>
#include "Arduino.h"
#include "SoftwareSerial.h"
#include "DFRobotDFPlayerMini.h"
#include <Wire.h>
#include <Adafruit_GFX.h>
#include <Adafruit_SSD1306.h>
#include <string.h>

#define RST_PIN 9
#define SS_PIN 10

const byte playPauseBtn = 4;
const byte randomBtn = 3;
const byte potenciometro = A0;
byte volIcon = 0;
byte volumen = 0;
byte lastVolumen = 0;
byte currSong = 0;
byte lastSong = 0;

byte repMode = 0; //0: no hace loop | 1: hace loop | 2:modo shuffle

bool isPlaying = false;
bool btnPPPress = false;
bool btnRndPress = false;

const byte SCREEN_WIDTH = 128;
const byte SCREEN_HEIGHT = 64;

SoftwareSerial mySoftwareSerial(5,6);

Adafruit_SSD1306 display(SCREEN_WIDTH, SCREEN_HEIGHT, &Wire, -1);
DFRobotDFPlayerMini myDFPlayer;

//void printDetail(uint8_t type, int value);

int sw_frame = 0;

MFRC522 mfrc522(SS_PIN, RST_PIN);

// 'v0', 19x13px
const unsigned char volumen_v0 [] PROGMEM = {
	0x03, 0x00, 0x00, 0x05, 0x00, 0x00, 0x09, 0x00, 0x00, 0x11, 0x00, 0x00, 0xe1, 0x11, 0x00, 0x81, 
	0x0a, 0x00, 0x81, 0x04, 0x00, 0x81, 0x0a, 0x00, 0xe1, 0x11, 0x00, 0x11, 0x00, 0x00, 0x09, 0x00, 
	0x00, 0x05, 0x00, 0x00, 0x03, 0x00, 0x00
};
// 'v4', 19x13px
const unsigned char volumen_v4 [] PROGMEM = {
	0x03, 0x00, 0x00, 0x05, 0x01, 0x00, 0x09, 0x08, 0x80, 0x11, 0x04, 0x40, 0xe1, 0x22, 0x40, 0x81, 
	0x12, 0x40, 0x81, 0x52, 0x40, 0x81, 0x12, 0x40, 0xe1, 0x22, 0x40, 0x11, 0x04, 0x40, 0x09, 0x08, 
	0x80, 0x05, 0x01, 0x00, 0x03, 0x00, 0x00
};
// 'v3', 19x13px
const unsigned char volumen_v3 [] PROGMEM = {
	0x03, 0x00, 0x00, 0x05, 0x00, 0x00, 0x09, 0x08, 0x00, 0x11, 0x04, 0x00, 0xe1, 0x22, 0x00, 0x81, 
	0x12, 0x00, 0x81, 0x52, 0x00, 0x81, 0x12, 0x00, 0xe1, 0x22, 0x00, 0x11, 0x04, 0x00, 0x09, 0x08, 
	0x00, 0x05, 0x00, 0x00, 0x03, 0x00, 0x00
};
// 'v2', 19x13px
const unsigned char volumen_v2 [] PROGMEM = {
	0x03, 0x00, 0x00, 0x05, 0x00, 0x00, 0x09, 0x00, 0x00, 0x11, 0x00, 0x00, 0xe1, 0x20, 0x00, 0x81, 
	0x10, 0x00, 0x81, 0x50, 0x00, 0x81, 0x10, 0x00, 0xe1, 0x20, 0x00, 0x11, 0x00, 0x00, 0x09, 0x00, 
	0x00, 0x05, 0x00, 0x00, 0x03, 0x00, 0x00
};
// 'v1', 19x13px
const unsigned char volumen_v1 [] PROGMEM = {
	0x03, 0x00, 0x00, 0x05, 0x00, 0x00, 0x09, 0x00, 0x00, 0x11, 0x00, 0x00, 0xe1, 0x00, 0x00, 0x81, 
	0x00, 0x00, 0x81, 0x40, 0x00, 0x81, 0x00, 0x00, 0xe1, 0x00, 0x00, 0x11, 0x00, 0x00, 0x09, 0x00, 
	0x00, 0x05, 0x00, 0x00, 0x03, 0x00, 0x00
};

// Array of all bitmaps for convenience. (Total bytes used to store images in PROGMEM = 320)
//const int volumen_allArray_LEN = 5;
const unsigned char* volumen_allArray[5] = {
	volumen_v0,
	volumen_v1,
	volumen_v2,
	volumen_v3,
	volumen_v4
};

// 'linear', 17x13px
const unsigned char reproductor_linear [] PROGMEM = {
	0x00, 0x80, 0x00, 0x01, 0x80, 0x00, 0x02, 0x80, 0x00, 0x00, 0x80, 0x00, 0x00, 0x80, 0x00, 0x00, 
	0x80, 0x00, 0x00, 0x80, 0x00, 0x03, 0xe0, 0x00, 0x00, 0x02, 0x00, 0x00, 0x03, 0x00, 0xff, 0xff, 
	0x80, 0x00, 0x03, 0x00, 0x00, 0x02, 0x00
};
// 'loop', 17x13px
const unsigned char reproductor_loop [] PROGMEM = {
	0x3f, 0xfe, 0x00, 0x40, 0x81, 0x00, 0x81, 0x40, 0x80, 0x82, 0x20, 0x80, 0x82, 0x20, 0x80, 0x83, 
	0xe0, 0x80, 0x82, 0x20, 0x80, 0x82, 0x20, 0x80, 0x88, 0x00, 0x80, 0x4c, 0x41, 0x00, 0x3e, 0x7e, 
	0x00, 0x0c, 0x40, 0x00, 0x08, 0x00, 0x00
};
// 'shuffle', 17x13px
const unsigned char reproductor_shuffle [] PROGMEM = {
	0x00, 0x02, 0x00, 0x00, 0x03, 0x00, 0xf0, 0x1f, 0x80, 0x08, 0x23, 0x00, 0x04, 0x42, 0x00, 0x02, 
	0x80, 0x00, 0x01, 0x00, 0x00, 0x02, 0x80, 0x00, 0x04, 0x42, 0x00, 0x08, 0x23, 0x00, 0xf0, 0x1f, 
	0x80, 0x00, 0x03, 0x00, 0x00, 0x02, 0x00
};

// Array of all bitmaps for convenience. (Total bytes used to store images in PROGMEM = 192)
//const int reproductor_allArray_LEN = 3;
const unsigned char* reproductor_allArray[3] = {
	reproductor_linear,
	reproductor_loop,
	reproductor_shuffle
};

// 'play', 7x13px
const unsigned char playstop_play [] PROGMEM = {
	0x80, 0xc0, 0xe0, 0xf0, 0xf8, 0xfc, 0xfe, 0xfc, 0xf8, 0xf0, 0xe0, 0xc0, 0x80
};
// 'stop', 7x13px
const unsigned char playstop_stop [] PROGMEM = {
	0xc6, 0xc6, 0xc6, 0xc6, 0xc6, 0xc6, 0xc6, 0xc6, 0xc6, 0xc6, 0xc6, 0xc6, 0xc6
};

// Array of all bitmaps for convenience. (Total bytes used to store images in PROGMEM = 64)
//const int playstop_allArray_LEN = 2;
const unsigned char* playstop_allArray[2] = {
	playstop_stop,
	playstop_play
};

// 'sw0', 46x24px
const unsigned char soundwave_sw0 [] PROGMEM = {
	0x00, 0x00, 0x00, 0x00, 0x00, 0x00, 0x00, 0x00, 0x00, 0x00, 0x00, 0x00, 0x00, 0x00, 0x00, 0x00, 
	0x00, 0x00, 0x00, 0x00, 0x00, 0x00, 0x00, 0x00, 0x00, 0x00, 0x00, 0x00, 0x00, 0x00, 0x00, 0x00, 
	0x00, 0x00, 0x00, 0x00, 0x00, 0x00, 0x00, 0x00, 0x00, 0x00, 0x00, 0x00, 0x00, 0x00, 0x00, 0x00, 
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	0x00, 0x00, 0x00, 0x00, 0x00, 0x00, 0x00, 0x00, 0x00, 0x00, 0x00, 0x00, 0x00, 0x00, 0x00, 0x00
};
// 'sw2', 46x24px
const unsigned char soundwave_sw2 [] PROGMEM = {
	0x00, 0x00, 0x00, 0x00, 0x00, 0x00, 0x00, 0x00, 0x00, 0x00, 0x00, 0x00, 0x00, 0x00, 0x00, 0x00, 
	0x00, 0x00, 0x00, 0x00, 0x00, 0x00, 0x01, 0x00, 0x00, 0x00, 0x00, 0x00, 0x01, 0x00, 0x00, 0x00, 
	0x00, 0x80, 0x01, 0x04, 0x10, 0x00, 0x04, 0x80, 0x41, 0x04, 0x10, 0x08, 0x24, 0x82, 0x41, 0x04, 
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	0x00, 0x00, 0x00, 0x00, 0x00, 0x00, 0x00, 0x00, 0x00, 0x00, 0x00, 0x00, 0x00, 0x00, 0x00, 0x00
};
// 'sw3', 46x24px
const unsigned char soundwave_sw3 [] PROGMEM = {
	0x00, 0x00, 0x00, 0x00, 0x00, 0x00, 0x00, 0x00, 0x00, 0x00, 0x00, 0x00, 0x00, 0x00, 0x00, 0x00, 
	0x00, 0x04, 0x10, 0x00, 0x00, 0x00, 0x00, 0x04, 0x10, 0x40, 0x04, 0x00, 0x00, 0x04, 0x10, 0x40, 
	0x04, 0x10, 0x01, 0x04, 0x12, 0x48, 0x04, 0x10, 0x01, 0x04, 0x12, 0x48, 0x04, 0x90, 0x01, 0x04, 
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	0x00, 0x00, 0x00, 0x00, 0x00, 0x00, 0x00, 0x00, 0x00, 0x00, 0x00, 0x00, 0x00, 0x00, 0x00, 0x00
};
// 'sw1', 46x24px
const unsigned char soundwave_sw1 [] PROGMEM = {
	0x00, 0x00, 0x00, 0x00, 0x00, 0x00, 0x00, 0x00, 0x00, 0x80, 0x00, 0x00, 0x00, 0x00, 0x00, 0x80, 
	0x00, 0x00, 0x00, 0x00, 0x00, 0x80, 0x00, 0x00, 0x00, 0x00, 0x00, 0x80, 0x00, 0x00, 0x00, 0x00, 
	0x20, 0x90, 0x01, 0x00, 0x00, 0x00, 0x20, 0x90, 0x01, 0x04, 0x00, 0x01, 0x24, 0x90, 0x01, 0x24, 
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	0x00, 0x00, 0x00, 0x00, 0x00, 0x00, 0x00, 0x00, 0x00, 0x00, 0x00, 0x00, 0x00, 0x00, 0x00, 0x00
};
// 'sw5', 46x24px
const unsigned char soundwave_sw5 [] PROGMEM = {
	0x00, 0x00, 0x00, 0x00, 0x00, 0x00, 0x00, 0x00, 0x00, 0x00, 0x00, 0x00, 0x10, 0x00, 0x00, 0x02, 
	0x01, 0x00, 0x10, 0x00, 0x00, 0x02, 0x01, 0x00, 0x10, 0x40, 0x04, 0x02, 0x41, 0x00, 0x10, 0x40, 
	0x04, 0x02, 0x41, 0x20, 0x12, 0x40, 0x24, 0x02, 0x41, 0x20, 0x12, 0x41, 0x24, 0x02, 0x49, 0x20, 
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	0x00, 0x00, 0x00, 0x00, 0x00, 0x00, 0x00, 0x00, 0x00, 0x00, 0x00, 0x00, 0x00, 0x00, 0x00, 0x00
};
// 'sw4', 46x24px
const unsigned char soundwave_sw4 [] PROGMEM = {
	0x00, 0x00, 0x00, 0x00, 0x00, 0x00, 0x10, 0x00, 0x00, 0x00, 0x01, 0x00, 0x10, 0x00, 0x00, 0x00, 
	0x01, 0x20, 0x10, 0x40, 0x00, 0x00, 0x01, 0x20, 0x10, 0x40, 0x00, 0x00, 0x09, 0x20, 0x12, 0x40, 
	0x20, 0x02, 0x09, 0x20, 0x12, 0x40, 0x20, 0x12, 0x09, 0x24, 0x92, 0x48, 0x24, 0x12, 0x49, 0x24, 
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	0x00, 0x00, 0x00, 0x00, 0x00, 0x00, 0x00, 0x00, 0x00, 0x00, 0x00, 0x00, 0x00, 0x00, 0x00, 0x00
};

// Array of all bitmaps for convenience. (Total bytes used to store images in PROGMEM = 960)
const unsigned char* soundwave_allArray[11] = {
	soundwave_sw0,
	soundwave_sw1,
  soundwave_sw1,
	soundwave_sw2,
  soundwave_sw2,
	soundwave_sw3,
  soundwave_sw3,
	soundwave_sw4,
  soundwave_sw4,
	soundwave_sw5,
  soundwave_sw5
};


const byte VOL_WIDTH = 19;
const byte VOL_HEIGHT = 13;

const byte PLAYSTOP_WIDTH = 7;
const byte PLAYSTOP_HEIGHT = 13;

const byte REPRODUCTOR_WIDTH = 17;
const byte REPRODUCTOR_HEIGHT = 13;

const byte SW_WIDTH = 46;
const byte SW_HEIGHT = 24;

unsigned long ultimoCheck = 0;
const long intervalo = 1500;
const long intervaloRnd = 2000; //tiempo para que se active o desactive el shuffle :)
const long intervaloRFID = 1000;
unsigned long inicioPresionRnd = 0; 
bool pasaIntervalo = false;
unsigned long ultimoCheckRFID = 0;
int numCanciones = 0;


void displayBitmaps(){
  display.drawBitmap( (display.width() - VOL_WIDTH - REPRODUCTOR_WIDTH - 2),(display.height() - VOL_HEIGHT),volumen_allArray[volIcon], VOL_WIDTH, VOL_HEIGHT, 1 );
  display.drawBitmap( (display.width() - PLAYSTOP_WIDTH)/2,(display.height() - PLAYSTOP_HEIGHT),playstop_allArray[int(isPlaying)], PLAYSTOP_WIDTH, PLAYSTOP_HEIGHT, 1 );
  display.drawBitmap( (display.width() - REPRODUCTOR_WIDTH),(display.height() - REPRODUCTOR_HEIGHT),reproductor_allArray[repMode], REPRODUCTOR_WIDTH, REPRODUCTOR_HEIGHT, 1 );
  //display.drawBitmap( (display.width() - SW_WIDTH)/2,8,soundwave_allArray[sw_frame], SW_WIDTH, SW_HEIGHT, 1 );

  display.drawLine(0, display.height()- PLAYSTOP_HEIGHT - 2, display.width(), display.height()- PLAYSTOP_HEIGHT - 2, SSD1306_WHITE);
}

//const byte SW_WIDTH = 46;
//const byte SW_HEIGHT = 24;

void setup(){
   Serial.begin(9600);
   mySoftwareSerial.begin(9600);
   SPI.begin();
   mfrc522.PCD_Init();
   display.begin(SSD1306_SWITCHCAPVCC, 0x3C);
   
   display.clearDisplay();
   display.setTextSize(2);
   display.setTextColor(WHITE);
   display.setTextWrap(false);
   display.println("Cargando...");
   display.display();

   pinMode(playPauseBtn, INPUT_PULLUP);
   pinMode(randomBtn, INPUT_PULLUP);

   while (!myDFPlayer.begin(mySoftwareSerial)){
    delay(100);
    Serial.println(F("No se pudo iniciar DFPlayer..."));
   }
   Serial.println(F("DFPlayer activo"));

   //Volumen inicial
   volumen = map(constrain(analogRead(potenciometro),9,1013),9,1013,0,30);
   myDFPlayer.volume(volumen);
   lastVolumen = volumen;
   if (volumen = 0){
    volIcon = 0;
   }else{
    volIcon = map(volumen, 1,30,1,4);
   }
   
   myDFPlayer.enableLoopAll();
   numCanciones = myDFPlayer.readFileCounts();
}

void loop(){
  unsigned long inicioLoop = millis();
  display_freeram();
  if (inicioLoop - ultimoCheck >= intervalo){
    //cada cierto tiempo actualiza cual cancion esta sonando
    ultimoCheck = inicioLoop;

    currSong = myDFPlayer.readCurrentFileNumber();
    

    if (currSong != lastSong){
      //hubo un cambio
      if (currSong == -1 || currSong == 255){
        //errores de lectura por parte del DFPlayer. No cambiara el numero
        currSong = lastSong;
      }else
      {
        //el cambio es valido
        //strcpy(message, nombres[currSong-1]);
      }
      
    }
    if (numCanciones == -1 || numCanciones == 1){
      numCanciones = myDFPlayer.readFileCounts();
    }
  }

  //preparativos RFID
  MFRC522::MIFARE_Key key;
  for (byte i = 0; i<6; i++) key.keyByte[i] = 0xFF;

  byte block;
  byte len;
  MFRC522::StatusCode status;

  //leer los inputs
  int p = analogRead(potenciometro);
  byte ppbtn = digitalRead(playPauseBtn); //LOW=0, eso es cuando esta activado, HIGH=1 y eso es cuando esta desactivado
  byte rndbtn = digitalRead(randomBtn);

  //====== actualizar volumen =======
  volumen = map(constrain(p,9,1013), 9, 1013, 0, 30);
  if (volumen != lastVolumen){
    myDFPlayer.volume(volumen);
    if (volumen == 0){
      volIcon = 0;
    }else{
      volIcon = map(volumen, 1,25,1,4);
    }
  }
  lastVolumen = volumen;
  //=================================

  //===== boton de play =============
  if (ppbtn == 0 && btnPPPress == false){
    //el boton acaba de ser presionado y aun no se ejecuta esta instruccion
    btnPPPress = true;

    if(isPlaying){
      isPlaying = false;
      myDFPlayer.pause();
    }else{
      isPlaying = true;
      myDFPlayer.start(); //resume la cancion que ya sonaba (o inicia la primera)
    }
  }
  if (btnPPPress && ppbtn == 1){
    //el boton dejó de ser presionado
    btnPPPress = false;
  }
  //=================================
  
  // ===== boton de modo ============
  if (rndbtn == 0 && btnRndPress == false){
    btnRndPress = true;
    inicioPresionRnd = inicioLoop; //puede haber desfase
  }
  if (btnRndPress == true){
    pasaIntervalo = ((inicioLoop - inicioPresionRnd) >= intervaloRnd);
  }
  

  if (btnRndPress && rndbtn == 1){
    btnRndPress = false;
    //ahora que el boton fue soltado, haremos la accion solo si no excedio el intervalo
    if (pasaIntervalo == false){
      if (repMode == 0){
        //pasamos al modo loop
        myDFPlayer.enableLoop();
        repMode = 1;
      }else if (repMode == 1){
        //desactivamos el loop
        myDFPlayer.disableLoop();
        myDFPlayer.enableLoopAll();
        repMode = 0;
      }else{
        //estamos en el modo shuffle, y volveremos al 0
        repMode = 0;
        myDFPlayer.play(currSong);
        myDFPlayer.disableLoop();
        myDFPlayer.enableLoopAll();
      }
    }
    
  }

  if (pasaIntervalo){
    //activamos modo shuffle
    repMode = 2;
    myDFPlayer.disableLoop();
    myDFPlayer.randomAll(); //esto hara que se reproduzca una nueva cancion y se continua aleatoriamente
    isPlaying = true;
    pasaIntervalo = false;
    inicioPresionRnd = 0;
  }
  //==============================================================================

  display.clearDisplay();

  //bitmaps
  displayBitmaps();

  //
  display.setTextSize(1);
  display.setCursor(0,display.height() - 10);
  display.print(currSong);
  display.print("/");
  display.print(numCanciones);
  
  //muestra las cosas efectivamente en pantalla
  display.display();

  if (isPlaying) {
    sw_frame += 1;
  } else {
    sw_frame = 0;
  }

  if (sw_frame > 8){
    sw_frame = 1;
  }

  //====== RFID =======
  if (mfrc522.PICC_IsNewCardPresent() && inicioLoop - ultimoCheckRFID >= intervaloRFID){
    ultimoCheckRFID = inicioLoop;
    if (! mfrc522.PICC_ReadCardSerial()){ return; }
    
    //Se detecta una tarjeta
    mfrc522.PICC_DumpDetailsToSerial(&(mfrc522.uid));

    byte buffer2[18];
    block = 1;
    len = 18;

    status = mfrc522.PCD_Authenticate(MFRC522::PICC_CMD_MF_AUTH_KEY_A, 1, &key, &(mfrc522.uid));
    if (status != MFRC522::STATUS_OK) {
      Serial.print(F("Fallo la autenticacion de la tarjeta: "));
      Serial.println(mfrc522.GetStatusCodeName(status));
      return;
    }

    status = mfrc522.MIFARE_Read(block, buffer2, &len);
    if (status != MFRC522::STATUS_OK) {
      Serial.print(F("Lectura fallida de la tarjeta: "));
      Serial.println(mfrc522.GetStatusCodeName(status));
      return;
    }

    String num = "";

    for (uint8_t i = 0; i < 16; i++)
    {
      num += (char)buffer2[i];
      Serial.println(buffer2[i]);
    }
    Serial.println(num.toInt());
    num.trim();
    Serial.println(num.toInt());

    myDFPlayer.play(num.toInt());
    isPlaying = true;

    mfrc522.PICC_HaltA();
    mfrc522.PCD_StopCrypto1();

  }

}
void display_freeram() {
  Serial.print(F("- SRAM left: "));
  Serial.println(freeRam());
}

int freeRam() {
  extern int __heap_start,*__brkval;
  int v;
  return (int)&v - (__brkval == 0  
    ? (int)&__heap_start : (int) __brkval);  
}